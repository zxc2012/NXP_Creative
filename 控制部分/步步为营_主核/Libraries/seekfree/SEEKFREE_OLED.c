/*!
*     COPYRIGHT NOTICE
*     Copyright (c) 2015,6zhaodong
*     All rights reserved.
*
*     除注明出处外，以下所有内容版权所属，未经允许，不得用于商业用途，
*     修改内容时必须版权声明。
*
* @file       OLED.c
* @brief      OLED底层函数
* @author     6zhaodong
* @version    v1.0
* @date       2015/9/19

*/

#include  "headfile.h"


#define LED_IMAGE_WHITE 0x01

const uint8 F6x8[][6] =
{
  { 0x00, 0x00, 0x00, 0x00, 0x00, 0x00 },   // sp
  { 0x00, 0x00, 0x00, 0x2f, 0x00, 0x00 },   // !
  { 0x00, 0x00, 0x07, 0x00, 0x07, 0x00 },   // "
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  { 0xFF, 0XFF, 0XFF, 0XFF, 0XFF, 0XFF }
};
//======================================================
// 128X64I液晶底层驱动[8X16]字体库
// 设计者: powerint
// 描  述: [8X16]西文字符的字模数据 (纵向取模,字节倒序)
// !"#$%&'()*+,-./0123456789:;<=>?@ABCDEFGHIJKLMNOPQRSTUVWXYZ[\]^_`abcdefghijklmnopqrstuvwxyz{|}~
//======================================================
const uint8 F8X16[]=
{
  0x00,0x00,0x00,0x00,0x00,0x00,0x00,0x00,0x00,0x00,0x00,0x00,0x00,0x00,0x00,0x00,// 0
  0x00,0x00,0x00,0xF8,0x00,0x00,0x00,0x00,0x00,0x00,0x00,0x33,0x30,0x00,0x00,0x00,//!1
  0x00,0x10,0x0C,0x06,0x10,0x0C,0x06,0x00,0x00,0x00,0x00,0x00,0x00,0x00,0x00,0x00,//"2
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  0x00,0x06,0x01,0x01,0x02,0x02,0x04,0x04,0x00,0x00,0x00,0x00,0x00,0x00,0x00,0x00,//~94

};
//数据水平，字节垂直
uint8 TESLA_BMP[] ={
0x00,0x00,0x00,0x00,0x00,0x00,0x00,0x00,0x00,0x00,0x00,0x00,0x00,0x00,
0x00,0x00,0x00,0x00,0x00,0x00,0x00,0x00,0x00,0x00,0x00,0x00,0x00,0x00,
0x00,0x00,0x00,0x00,0x00,0x00,0x00,0x00,0x00,0x00,0x00,0x00,0x00,0x00,
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0x00,0x00,0x00,0x00,0x00,0x00,0x00,0x00,/*"未命名文件",0*/
/* (128 X 64 )*/
};

/*************************************************************/
/*                     自定义图片数组                        */
/*************************************************************/
const unsigned char starting_up[1024]=
{0x00,0x00,0x00,0x00,0x00,0x00,0x00,0x00,0x00,0x00,0x00,0x00,0x00,0x00,0x00,0x00,
0x00,0x00,0x00,0x00,0x00,0x00,0x00,0x00,0x00,0x00,0x00,0x00,0x00,0x00,0x00,0x00,
0x00,0x00,0x00,0x00,0x00,0x00,0x00,0x00,0x00,0x00,0x00,0x00,0x00,0x00,0x00,0x00,
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0x00,0x00,0x00,0x00,0x00,0x00,0x00,0x00,0x00,0x00,0x00,0x00,0x00,0x00,0x00,0x00};




const unsigned char GO[1024]=
{0x00,0x00,0x00,0x00,0x00,0x00,0x00,0x00,0x40,0x40,0x40,0x40,0x40,0xF0,0x40,0x40,
0x40,0x40,0x40,0x00,0x00,0x00,0x00,0x00,0x80,0xE0,0x30,0x80,0xC0,0x60,0x50,0x40,
0x40,0x40,0x40,0x40,0xC0,0x00,0x00,0x00,0x00,0x00,0xE0,0x00,0x00,0x00,0x00,0x00,
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0xFF,0xFF,0xFF,0xFF,0xFF,0xFF,0xFF,0xFF,0xFF,0xFF,0xFF,0xFF,0xFF,0xFF,0xFF,0xFF};

//延时函数
void OLED_DLY_ms(uint16 ms)
{
  uint16 a;
  while(ms)
  {
    a=16000;
    while(a--);
    ms--;
  }
  return;
}
//初始化函数
void initOLED(void)
{

  gpio_init(OLED_SCL,GPO,1);//时钟初始化定义
  gpio_init(OLED_SDA,GPO,1);//数据口D0
  gpio_init(OLED_RST,GPO,0);//复位低能电平
  gpio_init(OLED_DC,GPO,1); //偏置常低

  OLED_RSTL;
  OLED_DLY_ms(50);
  OLED_RSTH;

  OLED_WrCmd(0xae);//--turn off oled panel
  OLED_WrCmd(0x00);//---set low column address
  OLED_WrCmd(0x10);//---set high column address
  OLED_WrCmd(0x40);//--set start line address  Set Mapping RAM Display Start Line (0x00~0x3F)
  OLED_WrCmd(0x81);//--set contrast control register
  OLED_WrCmd(0xcf); // Set SEG Output Current Brightness
  OLED_WrCmd(0xa1);//--Set SEG/Column Mapping     0xa0左右反置 0xa1正常
  OLED_WrCmd(0xc8);//Set COM/Row Scan Direction   0xc0上下反置 0xc8正常
  OLED_WrCmd(0xa6);//--set normal display
  OLED_WrCmd(0xa8);//--set multiplex ratio(1 to 64)
  OLED_WrCmd(0x3f);//--1/64 duty
  OLED_WrCmd(0xd3);//-set display offset	Shift Mapping RAM Counter (0x00~0x3F)
  OLED_WrCmd(0x00);//-not offset
  OLED_WrCmd(0xd5);//--set display clock divide ratio/oscillator frequency
  OLED_WrCmd(0x80);//--set divide ratio, Set Clock as 100 Frames/Sec
  OLED_WrCmd(0xd9);//--set pre-charge period
  OLED_WrCmd(0xf1);//Set Pre-Charge as 15 Clocks & Discharge as 1 Clock
  OLED_WrCmd(0xda);//--set com pins hardware configuration
  OLED_WrCmd(0x12);
  OLED_WrCmd(0xdb);//--set vcomh
  OLED_WrCmd(0x40);//Set VCOM Deselect Level
  OLED_WrCmd(0x20);//-Set Page Addressing Mode (0x00/0x01/0x02)
  OLED_WrCmd(0x02);//
  OLED_WrCmd(0x8d);//--set Charge Pump enable/disable
  OLED_WrCmd(0x14);//--set(0x10) disable
  OLED_WrCmd(0xa4);// Disable Entire Display On (0xa4/0xa5)
  OLED_WrCmd(0xa6);// Disable Inverse Display On (0xa6/a7)
  OLED_WrCmd(0xaf);//--turn on oled panel
  OLED_CLS();  //初始清屏
  OLED_Set_Pos(0,0);
}

//==============================================================
//函数名：LCD_P6x8Str(uint8 x,uint8 y,uint8 *p)
//功能描述：写入一组标准ASCII字符串
//参数：显示的位置（x,y），y为页范围0～7，要显示的字符串
//返回：无
//==============================================================
void OLED_P6x8Str(uint8 x,uint8 y,uint8 ch[])
{
  uint8 c=0,i=0,j=0;
  while (ch[j]!='\0')
  {
    c =ch[j]-32;
    if(x>126){x=0;y++;}
    OLED_Set_Pos(x,y);
    for(i=0;i<6;i++)
      OLED_WrDat(F6x8[c][i]);
    x+=6;
    j++;
  }
}

//==============================================================
//函数名：LCD_P8x16Str(uint8 x,uint8 y,uint8 *p)
//功能描述：写入一组标准ASCII字符串
//参数：显示的位置（x,y），y为页范围0～7，要显示的字符串
//返回：无
//==============================================================
void OLED_P8x16Str(uint8 x,uint8 y,uint8 ch[])
{
  uint8 c=0,i=0,j=0;

  while (ch[j]!='\0')
  {
    c =ch[j]-32;
    if(x>120){x=0;y++;}
    OLED_Set_Pos(x,y);
    for(i=0;i<8;i++)
      OLED_WrDat(F8X16[c*16+i]);
    OLED_Set_Pos(x,y+1);
    for(i=0;i<8;i++)
      OLED_WrDat(F8X16[c*16+i+8]);
    x+=8;
    j++;
  }
}
//==============================================================
//函数名： void Draw_BMP(uint8 x,uint8 y)
//功能描述：显示128×64的BMP图片
//参数：
//返回：无
//==============================================================
void OLED_BMP(uint8 bmp[])
{
  uint16 ii=0;
  uint8 x,y;

  for(y=0;y<=7;y++)
  {
    OLED_Set_Pos(0,y);
    for(x=0;x<=127;x++)
    {
      OLED_WrDat(bmp[ii++]);
    }
  }
}

/*****************************************************************************
 函 数 名  : OLED_int16
 功能描述  : 坐标、double数、小数位数
 输入参数  :
 输出参数  : 实际打在OLED屏幕上的数字个数（每个数字占宽6个像素点）
 返 回 值  : none
*****************************************************************************/
char OLED_int16(uint16 x,uint16 y,int16 num)
{
  int16 res=num;
  uint8 s[6],count = 0;
  OLED_P6x8Str(x,y,"      ");
  if(res>9999||res<-9999)
  {//5位数
    if(res>9999)
    {
      s[0]=(num/10000)%10+48;
      s[1]=(num/1000)%10+48;
      s[2]=(num/100)%10+48;
      s[3]=(num/10)%10+48;
      s[4]=num%10+48;
      s[5]='\0';
    }
    else
    {
      s[0]='-';
      res=-res;
      s[1]=(res/10000)%10+48;
      s[2]=(res/1000)%10+48;
      s[3]=(res/100)%10+48;
      s[4]=(res/10)%10+48;
      s[5]=res%10+48;

    }

  }
  else if((res>999||res<-999))
  {//4位数
    if(res>999)
    {
      s[0]=(num/1000)%10+48;
      s[1]=(num/100)%10+48;
      s[2]=(num/10)%10+48;
      s[3]=num%10+48;
      s[4]='\0';

    }
    else
    {
      s[0]='-';
      res=-res;
      s[1]=(res/1000)%10+48;
      s[2]=(res/100)%10+48;
      s[3]=(res/10)%10+48;
      s[4]=res%10+48;

    }
    s[5]='\0';
  }
  else if((res>99||res<-99))
  {//3位数
    if(res>99)
    {
      s[0]=(num/100)%10+48;
      s[1]=(num/10)%10+48;
      s[2]=num%10+48;
      s[3]='\0';
    }
    else
    {
      s[0]='-';
      res=-res;
      s[1]=(res/100)%10+48;
      s[2]=(res/10)%10+48;
      s[3]=res%10+48;

    }
    s[4]='\0';
    s[5]=' ';
  }
  else if((res>9||res<-9))
  {//2位数
    if(res>9)
    {
      s[0]=(num/10)%10+48;
      s[1]=num%10+48;
      s[2]='\0';
    }
    else
    {
      s[0]='-';
      res=-res;
      s[1]=(res/10)%10+48;
      s[2]=res%10+48;

    }
    s[3]='\0';
    s[4]=' ';
    s[5]=' ';
  }
  else
  {//1位数
    if(res>=0)
    {
      s[0]=num%10+48;
      s[1]='\0';
    }
    else
    {
      s[0]='-';
      res=-res;
      s[1]=res%10+48;

    }
    s[2]='\0';
    s[3]=' ';
    s[4]=' ';
    s[5]=' ';

  }
  OLED_P6x8Str(x,y,s);
  return strlen(s);
}

/*****************************************************************************
 函 数 名  : double （其实是float，改成double将出错）
 功能描述  : 坐标、double数、小数位数
 输入参数  :
 输出参数  : none
 返 回 值  : none
*****************************************************************************/
void OLED_double(uint16 a,uint16 b,double number,char precision)
{
  int16 decimal,integer,count=0;
  OLED_P6x8Str(a,b,"      ");
  if(number<0){
    OLED_P6x8Str(a,b,"-");
    number = -number;
    a+=6;
  }
  integer = (int16)number;
  count = OLED_int16(a,b,integer);     //Integer Display
  a+=6*count;
  decimal = (int16)((number - integer)*pow(10,precision));
  if(precision!=0)
  {
    OLED_P6x8Str(a,b,".");
    for(count=precision-1;count>=0;count--)
    {
      OLED_int16(a+6*(count+1),b,decimal%10);
      decimal /= 10;
    }
  }
}

//写数据的函数
void OLED_WrDat(uint8 data)
{
  uint8 i=8;
  OLED_DCH;
  OLED_SCLL;
  while(i--)
  {
    if(data&0x80){OLED_SDAH;}
    else{OLED_SDAL;}
    OLED_SCLH;
    asm("nop");
    OLED_SCLL;
    data<<=1;
  }
}
//写指令的函数
void OLED_WrCmd(uint8 cmd)
{
  uint8 i=8;
  OLED_DCL;
  OLED_SCLL;
  while(i--)
  {
    if(cmd&0x80){OLED_SDAH;}
    else{OLED_SDAL;}
    OLED_SCLH;;
    asm("nop");
    OLED_SCLL;
    cmd<<=1;
  }
}
//设置坐标的函数
void OLED_Set_Pos(uint8 x, uint8 y)
{
  OLED_WrCmd(0xb0+y);
  OLED_WrCmd(((x&0xf0)>>4)|0x10);
  OLED_WrCmd((x&0x0f)/*|0x01*/);
}

//清屏的函数
void OLED_CLS(void)
{
  uint8 y,x;
  for(y=0;y<8;y++)
  {
    OLED_WrCmd(0xb0+y);
    OLED_WrCmd(0x01);
    OLED_WrCmd(0x10);
    for(x=0;x<X_WIDTH;x++)
      OLED_WrDat(0);
  }
}

/*************************************************************/
/*                       OLED显示图片                        */
/*************************************************************/
void OLED_image1(void)
{
    unsigned int xx,yy;
    for(yy=0;yy<8;yy++)
    {
        OLED_Set_Pos(0,yy);
        for(xx=0;xx<128;xx++)
            OLED_WrDat(starting_up[yy*128+xx]);
    }
}

void OLED_image2(void)
{
    unsigned int xx,yy;
    for(yy=0;yy<8;yy++)
    {
        OLED_Set_Pos(0,yy);
        for(xx=0;xx<128;xx++)
            OLED_WrDat(GO[yy*128+xx]);
    }
}

/*OLED显示图片*/
uint8  bmp_buff[1024]={0};
uint8  compress_buff[120][128]={0};
void Draw_Picture(uint8 x0,uint8 y0,uint8 x1,uint8 y1,uint8 bmp[])
{

  int32 i,j,k;

//  for(i=0;i<=127;i++,i++)
//    for(j=0;j<=15;j++)
//      for(k=0;k<=7;k++)
//        bmp_buff[j*8+k+(i/16)*128]+=(((buff[i*10+j]>>(7-k))&(0x01))<<((i%16)/2));

  for(i=0;i<=119;i++)
  {
    for(j=0;j<=159;j++)
    {
      compress_buff[i][j*127/159]=img[i][j]>200;
    }
  }

  for(i=0;i<=119;i++)
  {
    for(j=0;j<=127;j++)
    {
      compress_buff[i*63/119][j]=compress_buff[i][j];
    }
  }


  for(i=0;i<=7;i++)
  {
    for(j=0;j<=127;j++)
    {
      for(k=0;k<=7;k++)
      {
        bmp_buff[i*128+j]+=(((*(compress_buff+ i*8+k ))[j])<<k);
      }
    }
  }

//  for(i=0;i<=7;i++)
//  {
//    bmp_buff[63+i*128]=~bmp_buff[63+i*128];
//    bmp_buff[64+i*128]=~bmp_buff[63+i*128];
//  }
//
//  for(i=0;i<=127;i++)
//  {
//    bmp_buff[384+i]^=(1<<7);
//    bmp_buff[512+i]^=(1<<0);
//  }

//  for(i=0;i<=63;i++)
//    for(j=0;j<=127;j++)
//      bmp_buff[(i/8)*128+j]+=((*(compress_buff+i))[j]<<(i%8));

  uint32 ii=0;
  uint8 x,y;

  if(y1%8==0) y=y1/8;
  else y=y1/8+1;

  for(y=y0;y<=y1;y++)
  {
   OLED_Set_Pos(x0,y);
    for(x=x0;x<=x1;x++)
    {
        OLED_WrDat(bmp[ii]);
        bmp[ii]=0;
        ii++;
    }
  }


}
