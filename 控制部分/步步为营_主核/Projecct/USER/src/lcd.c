#include "headfile.h"



#define XLevelL		0x00
#define XLevelH		0x10
#define XLevel		((XLevelH&0x0F)*16+XLevelL)
#define Max_Column	128
#define Max_Row		  64
#define	Brightness	0xCF

// extern uint8 img[CAMERA_W*CAMERA_H];
#define X_WIDTH 128
#define Y_WIDTH 64
byte beyond64x64_1[512]  =
{
0xF0,0xF8,0xFC,0xFE,0xFF,0xFF,0xFF,0xFF,0xFF,0xFF,0xFF,0xFF,0x3F,0x07,0x00,0x00,
0x00,0x00,0x00,0x00,0x00,0x80,0xE0,0xF0,0xF8,0xFC,0xFE,0xFE,0xFF,0xFF,0xFF,0xFF,
0xFF,0xFF,0xFF,0xFF,0xFF,0xFF,0xFF,0x7F,0x3F,0x3F,0x1F,0x1F,0x1F,0x0F,0x0F,0x0F,
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0x07,0x0F,0x1F,0x3F,0x3F,0x7F,0xFF,0xFF,0xFF,0xFF,0xFF,0xFF,0x7F,0x7F,0x3F,0x0F,
};


byte beyond64x64_2[512]  =
{

0x00,0xF0,0xF0,0x10,0x10,0x10,0x30,0xE0,0xC0,0x00,0x00,0x00,0x00,0x00,0x00,0x00,
0x00,0x00,0x00,0x00,0x00,0x00,0x00,0x00,0x00,0x00,0x00,0x00,0x00,0x00,0x00,0x00,
0x00,0x00,0x00,0x00,0x00,0x00,0x00,0x00,0x00,0x00,0x00,0x00,0x00,0x00,0x00,0x00,
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0x07,0x07,0x04,0x04,0x04,0x04,0x04,0x04,0x04,0x07,0x07,0x00,0x00,0x00,0x00,0x00,
};

void LCD_WrDat(byte data)
{
	byte i=8;
        DC_data;
        SCL_0;
        while(i--)
        {
                if(data&0x80)
                {
                        SDA_1;
                }
                else
                {
                        SDA_0;
                }
                SCL_1;
                asm("nop");
                SCL_0;
                data<<=1;
        }
 }


void LCD_WrCmd(byte cmd)
{
	byte i=8;
        DC_cmd;
        SCL_0;

        while(i--)
        {
                if(cmd&0x80)
                {
                         SDA_1;
                }
                else
                {
                         SDA_0;
                }
                SCL_1;
                asm("nop");
                SCL_0;
                cmd<<=1;
        }
}
void LCD_Set_Pos(byte x, byte y)
{
  LCD_WrCmd(0xb0+y);
  LCD_WrCmd(((x&0xf0)>>4)|0x10);
  LCD_WrCmd(x&0x0f|0x00);                                    //|0x01);原来的版本图像整体右移一列，导致低128列移到第一列显示，不知道这么做是为什么，暂时先改回来
}
void LCD_Fill(byte img_data)
{
	byte y,x;

	for(y=0;y<8;y++)
	{
		LCD_WrCmd(0xb0+y);
		LCD_WrCmd(0x01);
		LCD_WrCmd(0x10);
		for(x=0;x<X_WIDTH;x++)
			LCD_WrDat(img_data);
	}
}
void LCD_CLS(void)		//清屏
{
	byte y,x;
	for(y=0;y<8;y++)
	{
		LCD_WrCmd(0xb0+y);
		LCD_WrCmd(0x00);
		LCD_WrCmd(0x10);
		for(x=0;x<X_WIDTH;x++)
			LCD_WrDat(0);
	}
}
void LCD_DLY_ms(word ms)
{
  word a;
  while(ms)
  {
    a=23350;
    while(a--);
    ms--;
  }
  return;
}


void LCD_Init(void)
{
  SCL_FIRST;
  SDA_FIRST;
  DC_FIRST;
  REST_FIRST;

  SCL_1;
  REST_0;
  LCD_DLY_ms(100);
  REST_1;

  LCD_WrCmd(0xae);//--turn off oled panel
  LCD_WrCmd(0x00);//---set low column address
  LCD_WrCmd(0x10);//---set high column address
  LCD_WrCmd(0x40);//--set start line address  Set Mapping RAM Display Start Line (0x00~0x3F)
  LCD_WrCmd(0x81);//--set contrast control register
  LCD_WrCmd(0xcf); // Set SEG Output Current Brightness
  LCD_WrCmd(0xa1);//--Set SEG/Column Mapping     0xa0左右反置 0xa1正常
  LCD_WrCmd(0xc8);//Set COM/Row Scan Direction   0xc0上下反置 0xc8正常
  LCD_WrCmd(0xa6);//--set normal display
  LCD_WrCmd(0xa8);//--set multiplex ratio(1 to 64)
  LCD_WrCmd(0x3f);//--1/64 duty
  LCD_WrCmd(0xd3);//-set display offset	Shift Mapping RAM Counter (0x00~0x3F)
  LCD_WrCmd(0x00);//-not offset
  LCD_WrCmd(0xd5);//--set display clock divide ratio/oscillator frequency
  LCD_WrCmd(0x80);//--set divide ratio, Set Clock as 100 Frames/Sec
  LCD_WrCmd(0xd9);//--set pre-charge period
  LCD_WrCmd(0xf1);//Set Pre-Charge as 15 Clocks & Discharge as 1 Clock
  LCD_WrCmd(0xda);//--set com pins hardware configuration
  LCD_WrCmd(0x12);
  LCD_WrCmd(0xdb);//--set vcomh
  LCD_WrCmd(0x40);//Set VCOM Deselect Level
  LCD_WrCmd(0x20);//-Set Page Addressing Mode (0x00/0x01/0x02)
  LCD_WrCmd(0x02);//
  LCD_WrCmd(0x8d);//--set Charge Pump enable/disable
  LCD_WrCmd(0x14);//--set(0x10) disable
  LCD_WrCmd(0xa4);// Disable Entire Display On (0xa4/0xa5)
  LCD_WrCmd(0xa6);// Disable Inverse Display On (0xa6/a7)
  LCD_WrCmd(0xaf);//--turn on oled panel
  LCD_Fill(0x00);  //初始清屏
  LCD_Set_Pos(0,0);

}

//输出汉字和字符混合字符串
void LCD_Print(unsigned char x, unsigned char y, unsigned char ch[])
{
	unsigned char ch2[3];
	unsigned char ii=0;
	while(ch[ii] != '\0')
	{
		if(ch[ii] > 127)
		{
			ch2[0] = ch[ii];
	 		ch2[1] = ch[ii + 1];
			ch2[2] = '\0';			//汉字为两个字节
			LCD_P6x8Str(x , y, ch2);	//显示汉字
			x += 14;
			ii += 2;
		}
		else
		{
			ch2[0] = ch[ii];
			ch2[1] = '\0';			//字母占一个字节
			LCD_P6x8Str(x , y , ch2);	//显示字母
			x += 8;
			ii+= 1;
		}
	}
}

//==============================================================
//函数名：LCD_P6x8Str(byte x,byte y,byte *p)
//功能描述：写入一组标准ASCII字符串
//参数：显示的位置（x,y），y为页范围0～7，要显示的字符串
//返回：无
//==============================================================
void LCD_P6x8Str(byte x,byte y,byte ch[])
{
  byte c=0,i=0,j=0;
  while (ch[j]!='\0')
  {
    c =ch[j]-32;
    if(x>126){x=0;y++;}
    LCD_Set_Pos(x,y);
  	for(i=0;i<6;i++)
  	  LCD_WrDat(F6x8[c][i]);
  	x+=6;
  	j++;
  }
}

void P_LCD_CLS(byte x,byte y)
{
        LCD_Set_Pos(x,y);
	//data1 = 0x01<<(y%8);
	LCD_WrCmd(0xb0+(y>>3));
	LCD_WrCmd(((x&0xf0)>>4)|0x10);
	LCD_WrCmd((x&0x0f)|0x00);
	LCD_WrDat(0);
}


//uint8 img_LCD[CAMERA_H*CAMERA_W]={0};
//void Img_Show(void)
//{
//
//  memcpy(img_LCD,img,sizeof(img));
//  uint8 i;
//  for(i=0;i<=79;i++)
//  {
//    img_LCD[30*80+i]=0;
//  }
//  for(i=55;i>=break_row;i--)
//  {
//    if(zhong[i]>=0&&zhong[i]<=80)
//  	img_LCD[i*80+zhong[i]]=0;
//  }
//  static uint8 rank=0; //列
//  static uint8 line=0; //行
//  static uint8 k=0;
//  static uint16 Data;
//  for(rank=0;rank<80;rank++)
//  {
//    for(line=0;line<8;line++)
//    {
//      Data=0x00;
//      LCD_Set_Pos((rank),line);
//      for(k=0;k<8;k++)
//      {
//        if(img_LCD[line*640+k*80+rank]==255)          //行数*160*8+每一行8位的位数*160+列数
//        {
//          Data=Data|(0x01<<k);
//        }
//        else
//          ;
//        }
//      LCD_WrDat(Data);
//    }
//  }
//}
//
//void Line_Show(void)
//{
//  uint8 i;
//  memset(img_LCD,0,sizeof(img_LCD));
//  for(i=0;i<=79;i++)
//  {
//    img_LCD[30*80+i]=255;
//  }
//  for(i=55;i>=break_row;i--)
//  {
//    if(zhong[i]>=0&&zhong[i]<=80)
//      img_LCD[i*80+zhong[i]]=255;
//    if(zuobian[i]>=0&&zhong[i]<=80)
//      img_LCD[i*80+zuobian[i]]=255;
//    if(zhong[i]>=0&&youbian[i]<=80)
//      img_LCD[i*80+youbian[i]]=255;
//  }
//  static uint8 rank=0; //列
//  static uint8 line=0; //行
//  static uint8 k=0;
//  static uint16 Data;
//  for(rank=0;rank<80;rank++)
//  {
//    for(line=0;line<8;line++)
//    {
//      Data=0x00;
//      LCD_Set_Pos((rank),line);
//      for(k=0;k<8;k++)
//      {
//        if(img_LCD[line*640+k*80+rank]==255)          //行数*160*8+每一行8位的位数*160+列数
//        {
//          Data=Data|(0x01<<k);
//        }
//        else
//          ;
//        }
//      LCD_WrDat(Data);
//    }
//  }
//}
